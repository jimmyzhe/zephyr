## boards/andestech/adp_xc7k_ae350/board.yml
```yaml
board:
  name: adp_xc7k
  vendor: andestech
  socs:
  - name: ae350
  - name: ae350_clic
```

## dts/bindings/interrupt-controller/andestech,eclic.yaml
```yaml
#
# Copyright (c) 2024, Andes Technology Corporation.
#
# SPDX-License-Identifier: Apache-2.0
#

description:
  This is a representation of Andes Technology Enhance Core Local Interrupt
  Controller node

compatible: "andestech,eclic"

include: [interrupt-controller.yaml, base.yaml]

properties:
  reg:
    required: true

  "#interrupt-cells":
    const: 2

interrupt-cells:
  - irq
  - priority
```
